## arch/m68k/68000/68kray/Kconfig
```kconfig
if 68KRAY

menu "68Kray setup"

config SERIAL_M6850_68KRAY
	bool "M6850 serial support"
	depends on 68KRAY
	select SERIAL_CORE
	help
	  This driver supports the M6850 module in the 68Kray M68K board.

config SERIAL_68KRAY_CONSOLE
	bool "M6850 serial console support"
	depends on SERIAL_M6850_68KRAY
	select SERIAL_CORE_CONSOLE
	help
	  Enables the M6850 module to be the system serial console.

endmenu

endif # 68KRAY
```

## arch/m68k/configs/68kray_defconfig
```kconfig
# CONFIG_LOCALVERSION_AUTO is not set
CONFIG_DEFAULT_HOSTNAME="68Kray"
# CONFIG_USELIB is not set
CONFIG_LOG_BUF_SHIFT=16
# CONFIG_UTS_NS is not set
# CONFIG_PID_NS is not set
CONFIG_BLK_DEV_INITRD=y
CONFIG_INITRAMFS_SOURCE="/home/gio/68000/linux/initramfs.cpio"
# CONFIG_RD_GZIP is not set
# CONFIG_RD_BZIP2 is not set
# CONFIG_RD_LZMA is not set
# CONFIG_RD_XZ is not set
# CONFIG_RD_LZO is not set
# CONFIG_RD_LZ4 is not set
# CONFIG_RD_ZSTD is not set
# CONFIG_INITRAMFS_PRESERVE_MTIME is not set
CONFIG_CC_OPTIMIZE_FOR_SIZE=y
# CONFIG_MMU is not set
CONFIG_M68KCLASSIC=y
CONFIG_68KRAY=y
CONFIG_RAMBASE=0x710000
CONFIG_RAMSIZE=0x8E0000
CONFIG_VECTORBASE=0x70FF3A
CONFIG_KERNELBASE=0x710000
CONFIG_SERIAL_M6850_68KRAY=y
CONFIG_SERIAL_68KRAY_CONSOLE=y
# CONFIG_SECCOMP is not set
# CONFIG_COMPAT_32BIT_TIME is not set
# CONFIG_BLOCK_LEGACY_AUTOLOAD is not set
# CONFIG_BLK_DEV_WRITE_MOUNTED is not set
# CONFIG_BINFMT_ELF_FDPIC is not set
CONFIG_BINFMT_FLAT=y
CONFIG_BINFMT_FLAT_OLD=y
CONFIG_BINFMT_ZFLAT=y
CONFIG_DEVTMPFS=y
CONFIG_DEVTMPFS_MOUNT=y
# CONFIG_STANDALONE is not set
# CONFIG_PREVENT_FIRMWARE_BUILD is not set
# CONFIG_BLK_DEV is not set
# CONFIG_INPUT_KEYBOARD is not set
# CONFIG_INPUT_MOUSE is not set
# CONFIG_SERIO is not set
# CONFIG_LEGACY_PTYS is not set
# CONFIG_LEGACY_TIOCSTI is not set
# CONFIG_LDISC_AUTOLOAD is not set
# CONFIG_HW_RANDOM is not set
# CONFIG_DEVMEM is not set
# CONFIG_HWMON is not set
# CONFIG_HID_SUPPORT is not set
# CONFIG_USB_SUPPORT is not set
# CONFIG_VIRTIO_MENU is not set
# CONFIG_VHOST_MENU is not set
# CONFIG_DNOTIFY is not set
# CONFIG_INOTIFY_USER is not set
# CONFIG_MISC_FILESYSTEMS is not set
CONFIG_INIT_STACK_NONE=y
# CONFIG_SECTION_MISMATCH_WARN_ONLY is not set
CONFIG_BOOTPARAM=y
CONFIG_BOOTPARAM_STRING="console=ttyS0,115200"
# CONFIG_RUNTIME_TESTING_MENU is not set
```
